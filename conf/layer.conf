## conf/layer.conf
```bitbake
# We have a conf and classes directory, add to BBPATH
BBPATH .= ":${LAYERDIR}"

# We have recipes-* directories, add to BBFILES
BBFILES += "${LAYERDIR}/recipes-*/*/*.bb \
            ${LAYERDIR}/recipes-*/*/*.bbappend"

BBFILE_COLLECTIONS += "meta-kp-antelope"
BBFILE_PATTERN_meta-kp-antelope = "^${LAYERDIR}/"
BBFILE_PRIORITY_meta-kp-antelope = "6"

LAYERDEPENDS_meta-kp-antelope = "core meta-kp-classes"
LAYERSERIES_COMPAT_meta-kp-antelope = "nanbield"
```

## conf/machine/antelope.conf
```bitbake
#@TYPE: Machine
#@NAME: antelope
#@DESCRIPTION: Machine configuration for the antelope boards.

#### Preamble
MACHINEOVERRIDES =. "${@['', 'antelope:']['antelope' !='${MACHINE}']}"
#### Regular settings follow

# Yocto device-tree variables
YAML_CONSOLE_DEVICE_CONFIG:pn-device-tree ?= "psu_uart_0"
YAML_MAIN_MEMORY_CONFIG:pn-device-tree ?= "PSU_DDR_0"
DT_PADDING_SIZE:pn-device-tree ?= "0x1000"
DTC_FLAGS:pn-device-tree ?= "-@"
YAML_DT_BOARD_FLAGS ?= "{BOARD template}"

# Yocto u-boot-xlnx variables
UBOOT_MACHINE ?= "xilinx_zynqmp_virt_defconfig"

# Yocto arm-trusted-firmware(TF-A) variables
ATF_CONSOLE_DEFAULT ?= "cadence"
TFA_BL33_LOAD ?= "0x8000000"

# Yocto PMUFW variables
YAML_COMPILER_FLAGS:append:pn-pmu-firmware = " "
YAML_SERIAL_CONSOLE_STDIN:pn-pmu-firmware ?= "psu_uart_0"
YAML_SERIAL_CONSOLE_STDOUT:pn-pmu-firmware ?= "psu_uart_0"

# Yocto FSBL variables
YAML_SERIAL_CONSOLE_STDIN:pn-fsbl-firmware ?= "psu_uart_0"
YAML_SERIAL_CONSOLE_STDOUT:pn-fsbl-firmware ?= "psu_uart_0"

# Yocto KERNEL Variables
UBOOT_ENTRYPOINT  ?= "0x200000"
UBOOT_LOADADDRESS ?= "0x200000"

# antelope Serial Console
SERIAL_CONSOLES ?= "115200;ttyPS0"
YAML_SERIAL_CONSOLE_BAUDRATE ?= "115200"

# Set DDR Base address for u-boot-xlnx-scr variables
DDR_BASEADDR ?= "0x0"
SKIP_APPEND_BASEADDR ?= "0"

# Required generic machine inclusion
require conf/machine/zynqmp-cg-generic.conf

#### No additional settings should be after the Postamble
#### Postamble
PACKAGE_EXTRA_ARCHS:append = "${@['', ' antelope']['antelope' != '${MACHINE}']}"

EXTRA_IMAGEDEPENDS:remove = "virtual/boot-bin"
IMAGE_BOOT_FILES = ""
```
